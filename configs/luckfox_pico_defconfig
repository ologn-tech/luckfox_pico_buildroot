## configs/luckfox_pico_defconfig
```kconfig
# Architecture
BR2_arm=y
BR2_cortex_a7=y

# Toolchain
BR2_TOOLCHAIN_EXTERNAL=y
BR2_TOOLCHAIN_EXTERNAL_ROCKCHIP_ARM=y

# System configuration
BR2_OPTIMIZE_3=y
BR2_TARGET_GENERIC_HOSTNAME="luckfox pico"
BR2_TARGET_GENERIC_ISSUE="Welcome to luckfox pico"
BR2_TARGET_GENERIC_ROOT_PASSWD="luckfox"
BR2_PACKAGE_BUSYBOX_SHOW_OTHERS=y
BR2_PACKAGE_PYTHON3=y
BR2_PACKAGE_PYTHON_COLORAMA=y
BR2_PACKAGE_PYTHON_FLASK=y
BR2_PACKAGE_PYTHON_KEYBOARD=y
BR2_PACKAGE_PYTHON_PYDANTIC=y
BR2_PACKAGE_PYTHON_SERIAL=y
BR2_PACKAGE_OPENCV4=y
BR2_PACKAGE_OPENCV4_LIB_FEATURES2D=y
BR2_PACKAGE_OPENCV4_LIB_HIGHGUI=y
BR2_PACKAGE_OPENCV4_LIB_PHOTO=y
BR2_PACKAGE_OPENCV4_LIB_PYTHON=y
BR2_PACKAGE_OPENCV4_LIB_VIDEO=y
BR2_PACKAGE_OPENCV4_WITH_RK=y

# Kernel
BR2_LINUX_KERNEL=y
BR2_LINUX_KERNEL_CUSTOM_GIT=y
BR2_LINUX_KERNEL_CUSTOM_REPO_URL="https://github.com/ologn-tech/luckfox_pico_kernel.git"
BR2_LINUX_KERNEL_CUSTOM_REPO_VERSION="5d04ae0fdc1b833a37147585a25d60a8e247d237"
BR2_LINUX_KERNEL_DEFCONFIG="luckfox_rv1106_linux"
BR2_LINUX_KERNEL_DTS_SUPPORT=y
BR2_LINUX_KERNEL_IMAGE_NAME="boot.img"
BR2_LINUX_KERNEL_IMAGE_TARGET_CUSTOM=y
BR2_LINUX_KERNEL_IMAGE_TARGET_NAME="zImage"
BR2_LINUX_KERNEL_INTREE_DTS_NAME="rv1103g-luckfox-pico-mini-b"

# Bootloader
BR2_TARGET_UBOOT=y
BR2_TARGET_UBOOT_BOARD_DEFCONFIG="luckfox_rv1106_uboot"
# BR2_TARGET_UBOOT_FORMAT_BIN is not set
BR2_TARGET_UBOOT_FORMAT_CUSTOM=y
BR2_TARGET_UBOOT_FORMAT_CUSTOM_NAME="uboot.img"
BR2_PACKAGE_HOST_UBOOT_TOOLS=y
BR2_PACKAGE_HOST_UBOOT_TOOLS_ENVIMAGE=y
BR2_PACKAGE_HOST_UBOOT_TOOLS_ENVIMAGE_SOURCE="board/luckfox-pico/uboot-env.txt"
BR2_PACKAGE_HOST_UBOOT_TOOLS_ENVIMAGE_SIZE="0x40000"

# Filesystem
BR2_ROOTFS_POST_IMAGE_SCRIPT="board/luckfox-pico/post-image.sh"
# BR2_TARGET_ROOTFS_TAR is not set
BR2_TARGET_ROOTFS_UBI=y
BR2_TARGET_ROOTFS_UBI_SUBSIZE=0
BR2_TARGET_ROOTFS_UBIFS_LEBSIZE=0x1f000
BR2_TARGET_ROOTFS_UBIFS_MAXLEBCNT=2047
BR2_TARGET_ROOTFS_UBIFS_OPTS="-F"
```

## package/python-keyboard/Config.in
```kconfig
config BR2_PACKAGE_PYTHON_KEYBOARD
	bool "python-keyboard"
	depends on BR2_PACKAGE_PYTHON3
	help
	  Hook and simulate keyboard events on Windows and Linux
```

## package/python-osc/Config.in
```kconfig
config BR2_PACKAGE_PYTHON_OSC
	bool "python-osc"
	depends on BR2_PACKAGE_PYTHON3
	help
	  Open Sound Control server and client implementations in pure Python.

	  https://github.com/attwad/python-osc
```

## package/python-pupil-detectors/Config.in
```kconfig
config BR2_PACKAGE_PYTHON_PUPIL_DETECTORS
	bool "python-pupil-detectors"
	depends on BR2_PACKAGE_PYTHON3
	depends on BR2_PACKAGE_PYTHON_NUMPY_ARCH_SUPPORTS
	depends on BR2_PACKAGE_OPENCV4
	select BR2_PACKAGE_EIGEN
	select BR2_PACKAGE_PYTHON_NUMPY
	help
	  Pupil Labs 2D Pupil Detector.

	  https://github.com/pupil-labs/pupil-detectors
```

## package/python-pye3d/Config.in
```kconfig
config BR2_PACKAGE_PYTHON_PYE3D
	bool "python-pye3d"
	depends on BR2_PACKAGE_PYTHON3
	depends on BR2_PACKAGE_PYTHON_NUMPY_ARCH_SUPPORTS
	select BR2_PACKAGE_EIGEN
	select BR2_PACKAGE_PYTHON_MSGPACK
	select BR2_PACKAGE_PYTHON_NUMPY
	select BR2_PACKAGE_PYTHON_SORTEDCONTAINERS
	help
	  3D eye model.

	  https://github.com/pupil-labs/pye3d-detector
```

## package/python-pynput/Config.in
```kconfig
config BR2_PACKAGE_PYTHON_PYNPUT
    bool "python-pynput"
    depends on BR2_PACKAGE_PYTHON3
    help
      Pynput is a library that allows controlling and monitoring input devices.
```

## package/python-usb-gadget/Config.in
```kconfig
config BR2_PACKAGE_PYTHON_USB_GADGET
    bool "python-usb-gadget"
    depends on BR2_PACKAGE_PYTHON3
    help
       A python library for creating and interfacing with USB Gadgets on Linux through libcomposite
```

## package/rkbin/Config.in
```kconfig
config BR2_PACKAGE_RKBIN
	bool "rkbin"
	select BR2_PACKAGE_LUCKFOX_PICO
	help
	  Rockchip binarines from luckfox-pico sdk

	  https://github.com/LuckfoxTECH/luckfox-pico/tree/main/sysdrv/source/uboot/rkbin
```
